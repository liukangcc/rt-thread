## bsp/esp32c3/Kconfig
```kconfig
mainmenu "RT-Thread Project Configuration"

config BSP_DIR
    string
    option env="BSP_ROOT"
    default "."

config RTT_DIR
    string
    option env="RTT_ROOT"
    default "../.."

config PKGS_DIR
    string
    option env="PKGS_ROOT"
    default "packages"

source "$RTT_DIR/Kconfig"
source "$PKGS_DIR/Kconfig"

config SOC_ESP32C3
    bool
    select ARCH_RISCV

config BOARD_ESP32C3_DEVKITM
    bool
    select SOC_ESP32C3
    select RT_USING_COMPONENTS_INIT
    select RT_USING_USER_MAIN
    default y

source "driver/Kconfig"

config __STACKSIZE__
    int "stack size for interrupt"
    default 4096
```
